## zenbedded_rcl/boards/native_sim.conf
```kconfig
# ── Ethernet / TAP ───────────────────────────────────────────────────────────
CONFIG_NET_DRIVERS=y
CONFIG_ETH_NATIVE_POSIX=y
CONFIG_NET_L2_ETHERNET=y

# ── Sockets ──────────────────────────────────────────────────────────────────
CONFIG_NET_SOCKETS=y
CONFIG_NET_SOCKETS_POSIX_NAMES=n         # still off — avoid any POSIX shim

# ── IP config ────────────────────────────────────────────────────────────────
CONFIG_NET_CONFIG_SETTINGS=y
CONFIG_NET_CONFIG_MY_IPV4_ADDR="192.168.1.10"
CONFIG_NET_CONFIG_MY_IPV4_GW="192.168.1.1"
CONFIG_NET_CONFIG_MY_IPV4_NETMASK="255.255.255.0"

# ── DNS ──────────────────────────────────────────────────────────────────────
CONFIG_DNS_RESOLVER=y
CONFIG_DNS_RESOLVER_MAX_SERVERS=2


CONFIG_POSIX_API=y
```

## zenbedded_rcl/sample.yaml
```yaml
sample:
  name: Zenbedded RCL
common:
  build_only: true
  tags: zenoh
tests:
  sample.zenbedded.rcl:
    platform_allow:
      - native_sim
      - esp32s3_devkitc/esp32s3/procpu
```

## zenbedded_transport/west.yml
```yaml
# File: zephyr_zenoh_transport/west.yml
manifest:
  projects:
    - name: zenoh-pico
      url: https://github.com/eclipse-zenoh/zenoh-pico.git
      # PR #1083 routes the Zephyr build through the templated config.h flow,
      # fixing the Z_FEATURE_* "redefined" -Werror failures. Drop back to a
      # tagged release once it lands upstream.
      revision: refs/pull/1083/head
      path: modules/lib/zenoh-pico
```
