## zenbedded_rcl/Kconfig
```kconfig
menu "Zenbedded RCL Configuration"

    config ZENBEDDED_RCL
        bool "Enable Zenbedded RCL"
        default y
        help
          This option enables the Zenbedded Ros Client Library (RCL).

    config ZENBEDDED_RCL_THREAD_PRIORITY
        int "Zenbedded thread priority"
        default 1
        help
            Zephyr thread priority for the zenbedded thread.
            Lower number = higher priority.

    config ZENBEDDED_RCL_THREAD_STACK_SIZE
        int "zenbedded thread stack size (bytes)"
        default 4096
        range 1024 16384
        help
            Stack size for the zenbedded thread.

    config ZENBEDDED_MAX_STATE_BUFFER_SIZE
        int "Maximum size of state message (for static allocation)"
        default 256

    config ZENBEDDED_MAX_CMD_BUFFER_SIZE
        int "Maximum size of cmd message (for static allocation)"
        default 256

    config ZENBEDDED_RCL_PUB_TOPIC
        string "Name of the topic for publishing"
        default "zenbedded/state"

    config ZENBEDDED_RCL_SUB_TOPIC
        string "name of the topic for subscribing"
        default "zenbedded/cmd"

    if ZENBEDDED_TIER_1
        choice ZENBEDDED_RCL_STATE_MSG_TYPE
            prompt "State (published) message type for tier 1"
            default ZENBEDDED_RCL_STATE_MSG_JOINT_STATE
            help
              ROS 2 message type serialized onto ZENBEDDED_RCL_PUB_TOPIC.

            config ZENBEDDED_RCL_STATE_MSG_IMU
                bool "sensor_msgs/msg/Imu"

            config ZENBEDDED_RCL_STATE_MSG_JOINT_STATE
                bool "sensor_msgs/msg/JointState"

            config ZENBEDDED_RCL_STATE_MSG_FLOAT64_MULTI_ARRAY
                bool "std_msgs/msg/Float64MultiArray"

            config ZENBEDDED_RCL_STATE_MSG_TWIST
                bool "geometry_msgs/msg/Twist"
        endchoice

        # Hidden string config for State message
        config ZENBEDDED_RCL_STATE_MSG_TYPE_STRING
            string
            default "sensor_msgs::msg::dds_::Imu_" if ZENBEDDED_RCL_STATE_MSG_IMU
            default "sensor_msgs::msg::dds_::JointState_" if ZENBEDDED_RCL_STATE_MSG_JOINT_STATE
            default "std_msgs::msg::dds_::Float64MultiArray_" if ZENBEDDED_RCL_STATE_MSG_FLOAT64_MULTI_ARRAY
            default "geometry_msgs::msg::dds_::Twist_" if ZENBEDDED_RCL_STATE_MSG_TWIST

        choice ZENBEDDED_RCL_CMD_MSG_TYPE
            prompt "Command (subscribed) message type"
            default ZENBEDDED_RCL_CMD_MSG_JOINT_COMMAND
            help
              ROS 2 message type deserialized from ZENBEDDED_RCL_SUB_TOPIC.

            config ZENBEDDED_RCL_CMD_MSG_JOINT_COMMAND
                bool "control_msgs/msg/JointCommand"

            config ZENBEDDED_RCL_CMD_MSG_FLOAT64_MULTI_ARRAY
                bool "std_msgs/msg/Float64MultiArray"

            config ZENBEDDED_RCL_CMD_MSG_TWIST
                bool "geometry_msgs/msg/Twist"
        endchoice

        # Hidden string config for Command message
        config ZENBEDDED_RCL_CMD_MSG_TYPE_STRING
            string
            default "control_msgs::msg::dds_::JointCommand_" if ZENBEDDED_RCL_CMD_MSG_JOINT_COMMAND
            default "std_msgs::msg::dds_::Float64MultiArray_" if ZENBEDDED_RCL_CMD_MSG_FLOAT64_MULTI_ARRAY
            default "geometry_msgs::msg::dds_::Twist_" if ZENBEDDED_RCL_CMD_MSG_TWIST

    endif # ZENBEDDED_TIER_1

endmenu
```

## zenbedded_transport/Kconfig
```kconfig
menu "Zenbedded Transport Configuration"

config ZENBEDDED_TRANSPORT_LOG_LEVEL
    int "Zenbedded Transport Log Level (0=OFF, 1=ERR, 2=WRN, 3=INF, 4=DBG)"
    default 2
    depends on LOG
    help
      Set to 4 (Debug) to expose raw Zenoh-pico wire-traces and KeepAlive logs
      during transport layer debugging. Keeps the user console clean by default.

choice ZENBEDDED_TRANSPORT_TIER
    prompt "Integration Tier"
    default ZENBEDDED_TIER_1

config ZENBEDDED_TIER_1
    bool "Tier 1: Native ROS 2 Integration (Zenbedded CDR)"
    select NETWORKING
    select NET_IPV4
    select NET_UDP
    select NET_TCP
    select NET_SOCKETS
    select POSIX_API
    select CBPRINTF_FP_SUPPORT
    select ZENOH_PICO
    select ZENOH_PICO_LINK_UDP_UNICAST
    select ZENOH_PICO_LINK_TCP
    select ZENOH_PICO_PUBLICATION
    select ZENOH_PICO_SUBSCRIPTION
    select ZENOH_PICO_FRAGMENTATION
    select ZENOH_PICO_RELIABILITY

config ZENBEDDED_TIER_2
    bool "Tier 2: High-Throughput Raw Numeric"
    select NETWORKING
    select NET_IPV4
    select NET_UDP
    select NET_TCP
    select NET_SOCKETS
    select POSIX_API
    select ZENOH_PICO
    select ZENOH_PICO_LINK_TCP
    select ZENOH_PICO_PUBLICATION
    select ZENOH_PICO_SUBSCRIPTION

config ZENBEDDED_TIER_3
    bool "Tier 3: Bit-Optimal Packed"

endchoice

# ==============================================================================
# TIER 2 CONFIGURATION
# ==============================================================================

config ZENBEDDED_TIER2_SCHEMA_PATH
    string "Path to Tier 2 YAML Schema"
    depends on ZENBEDDED_TIER_2
    default "config/interface_schema.yaml"
    help
      Path to the YAML schema file relative to the application's source directory.
      The build system will read this file to auto-generate the C-header struct.
      Fallback default is interface_schema.yaml in the app root.

# ==============================================================================
# SYSTEM DEFAULTS
# ==============================================================================

if ZENBEDDED_TIER_1

config NET_BUF_DATA_SIZE
    default 256

config NET_BUF_RX_COUNT
    default 16

config NET_BUF_TX_COUNT
    default 16

config NET_PKT_RX_COUNT
    default 16

config NET_PKT_TX_COUNT
    default 16

config HEAP_MEM_POOL_SIZE
    default 65536

config MAIN_STACK_SIZE
    default 16384

config SYSTEM_WORKQUEUE_STACK_SIZE
    default 8192

endif # ZENBEDDED_TIER_1

endmenu
```
