## CMakeLists.txt
```
cmake_minimum_required(VERSION 3.20.0)

list(APPEND ZEPHYR_EXTRA_MODULES
    ${CMAKE_CURRENT_SOURCE_DIR}/../../zenbedded_transport
    ${CMAKE_CURRENT_SOURCE_DIR}/../../zenbedded_rcl
)

find_package(Zephyr REQUIRED HINTS $ENV{ZEPHYR_BASE})
set(CMAKE_CXX_STANDARD 17)
set(CMAKE_CXX_STANDARD_REQUIRED ON)
set(CMAKE_CXX_EXTENSIONS OFF)

project(rcl_cpp_test)
target_sources(app PRIVATE src/main.cpp)

target_include_directories(app PRIVATE
        ${CMAKE_CURRENT_SOURCE_DIR}/../../zenbedded_rcl/include
)

add_custom_target(lib_dev_sync SOURCES
        ${CMAKE_CURRENT_SOURCE_DIR}/../../zenbedded_rcl/src
        ${CMAKE_CURRENT_SOURCE_DIR}/../../zenbedded_rcl/include
)
```

## sample.yaml
```
sample:
  name: Zenbedded RCL test
common:
  build_only: true
  tags: zenbedded_rcl
tests:
  sample.zenbedded.rcl_cpp_test:
    platform_allow:
      - esp32s3_devkitc/esp32s3/procpu
```

## prj.conf
```kconfig
CONFIG_CPP=y
CONFIG_STD_CPP17=y
CONFIG_GLIBCXX_LIBCPP=y

CONFIG_MULTITHREADING=y
CONFIG_POSIX_API=y

CONFIG_ZENBEDDED_TIER_2=y
CONFIG_ZENBEDDED_TIER2_SCHEMA_PATH="interface_schema.yaml"

CONFIG_NETWORKING=y
CONFIG_NET_IPV4=y
CONFIG_NET_UDP=y
CONFIG_NET_TCP=y
CONFIG_NET_DHCPV4=y

CONFIG_WIFI=y
CONFIG_INIT_STACKS=y
CONFIG_NET_SOCKETS=y
CONFIG_NET_L2_WIFI_MGMT=y
CONFIG_NET_L2_ETHERNET=y
CONFIG_NET_MGMT=y
CONFIG_NET_MGMT_EVENT=y
CONFIG_NET_MGMT_EVENT_INFO=y
CONFIG_NET_CONFIG_SETTINGS=y

CONFIG_ZENOH_PICO=y
CONFIG_ZENOH_PICO_LINK_UDP_UNICAST=y
CONFIG_ZENOH_PICO_LINK_TCP=y
CONFIG_ZENOH_PICO_PUBLICATION=y
CONFIG_ZENOH_PICO_SUBSCRIPTION=y
CONFIG_ZENOH_PICO_MULTI_THREAD=y
CONFIG_ZENOH_PICO_SCOUTING=y

CONFIG_LOG=y
CONFIG_TEST_RANDOM_GENERATOR=y
CONFIG_ENTROPY_GENERATOR=y

CONFIG_MAIN_THREAD_PRIORITY=5
CONFIG_MAIN_STACK_SIZE=8192

CONFIG_SHELL=y
CONFIG_NET_L2_WIFI_SHELL=y
CONFIG_WIFI_CREDENTIALS_SHELL=y
CONFIG_WIFI_NM=y
CONFIG_WIFI_CREDENTIALS=y
CONFIG_WIFI_CREDENTIALS_CONNECT_STORED=y

CONFIG_ZENBEDDED_RCL=y
CONFIG_ZENBEDDED_QOS_RELIABLE=y
CONFIG_ZENBEDDED_ZENOH_IP_PORT="10.75.105.128:7447"
CONFIG_ZENBEDDED_RCL_PUB_TOPIC="zenbedded/test/state"
CONFIG_ZENBEDDED_RCL_SUB_TOPIC="zenbedded/test/cmd"
```

## boards/esp32s3_devkitc_esp32s3_procpu.conf
```kconfig
# boards/esp32s3_devkitc_esp32s3_procpu.conf
# Extra Kconfig applied only when building for ESP32-S3

CONFIG_WIFI_ESP32=y
CONFIG_ESP32_WIFI_STA_AUTO_DHCPV4=y
CONFIG_ESP32_WIFI_STA_RECONNECT=y
CONFIG_SETTINGS=y
CONFIG_NVS=y
CONFIG_FLASH=y
CONFIG_FLASH_MAP=y
```

## src/main.cpp
```c
// Copyright 2026 Open Source Robotics Foundation, Inc.
//
// Licensed under the Apache License, Version 2.0 (the "License");
// you may not use this file except in compliance with the License.
// You may obtain a copy of the License at
//
//     http://www.apache.org/licenses/LICENSE-2.0
//
// Unless required by applicable law or agreed to in writing, software
// distributed under the License is distributed on an "AS IS" BASIS,
// WITHOUT WARRANTIES OR CONDITIONS OF ANY KIND, either express or implied.
// See the License for the specific language governing permissions and
// limitations under the License.

#include <esp_wifi.h>
#include <zenbedded_transport/generated/interface_data.h>
#include <zephyr/kernel.h>
#include <zephyr/logging/log.h>
#include <zephyr/net/net_if.h>
#include <zephyr/net/wifi_mgmt.h>
#include <cmath>
#include <zenbedded_rcl/zenbedded_client.hpp>

LOG_MODULE_REGISTER(zenbedded_test_node, LOG_LEVEL_INF);

using TestClient = ZenbeddedClient<RawCodec<zenbedded_state_t>, RawCodec<zenbedded_command_t>>;

constexpr uint32_t kControlFreqHz = 50;
constexpr int kIterations = 200;            // ~4s at 50Hz
constexpr int kWifiConnectTimeout = 15000;  // ms

static void report(bool pass, const char * msg)
{
  if (pass)
  {
    LOG_INF("PASS: %s", msg);
  }
  else
  {
    LOG_ERR("FAIL: %s", msg);
  }
}

int main(void)
{
  LOG_INF("starting test node");

  LOG_INF("starting Sine Wave Zephyr App");
  net_if * iface = net_if_get_default();

  LOG_INF("connecting to WiFi using stored credentials...");

  uint32_t timer = k_uptime_get_32();
  while (net_mgmt(NET_REQUEST_WIFI_CONNECT_STORED, iface, nullptr, 0) != 0)
  {
    if (k_uptime_get_32() - timer > kWifiConnectTimeout)
    {
      LOG_ERR("Wifi Connection Timedout ...");
      return -1;
    }
    LOG_ERR("WiFi connect-stored request failed... retrying...");
    k_sleep(K_MSEC(200));
  }

  LOG_INF("Connected... Waiting for IPV4 address");
  while (net_if_ipv4_get_global_addr(iface, NET_ADDR_PREFERRED) == nullptr)
  {
    k_sleep(K_MSEC(200));
  }
  LOG_INF("Got IPV4 address");

  // Disable Wi-Fi power saving
  esp_wifi_set_ps(WIFI_PS_NONE);
  k_sleep(K_MSEC(200));

  static TestClient client;

  int ret = client.init(kControlFreqHz);
  report(ret == 0, "client.init() returned 0");
  if (ret != 0)
  {
    LOG_ERR("init failed with %d, aborting", ret);
    return ret;
  }
  report(client.is_initialized(), "client.is_initialized() is true after init()");

  bool cmd_val_changed = false;
  int write_calls = 0;

  zenbedded_state_t s{};
  zenbedded_command_t cmd{};

  for (int i = 0; i < kIterations; i++)
  {
    double di = static_cast<double>(i);
    s.motor_arm_position = sin(di * 0.1) * 90.0;
    s.pendulum_axis_position = di * 0.01;

    client.write_state(s);
    write_calls++;

    client.read_command(cmd);

    if (i % 20 == 0)
    {
      LOG_INF(
        "iter=%d state.motor_arm=%.2f "
        "state.pendulum=%.2f cmd.motor_arm=%.2f",
        i, s.motor_arm_position, s.pendulum_axis_position, cmd.motor_arm_position);
    }

    // check if the value changes
    if (fabs(cmd.motor_arm_position) >= 1e-9)
    {
      cmd_val_changed = true;
    }

    k_sleep(K_MSEC(1000 / kControlFreqHz));
  }

  report(write_calls == kIterations, "write_state() called for every iteration without crashing");

  report(
    cmd_val_changed,
    "received at least one non-zero command "
    "(requires tools/zenoh_echo_node.py running)");

  LOG_INF("is_control_thread_running=%d", client.is_control_thread_running());

  // --- destroy() ---
  client.destroy();
  report(!client.is_initialized(), "client.destroy() left client uninitialized");

  LOG_INF("done");
  return 0;
}
```
