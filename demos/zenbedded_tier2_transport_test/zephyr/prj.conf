## CMakeLists.txt
```
cmake_minimum_required(VERSION 3.20.0)

# 1. Load the Transport Module
get_filename_component(WORKSPACE_DIR ${CMAKE_CURRENT_SOURCE_DIR}/../../.. ABSOLUTE)
list(APPEND ZEPHYR_EXTRA_MODULES ${WORKSPACE_DIR}/zenbedded_transport)

find_package(Zephyr REQUIRED HINTS $ENV{ZEPHYR_BASE})
project(zenbedded_tier2_test)

# 2. Run the Native Python Generator (The Clean Fix)
set(SCHEMA_FILE "${CMAKE_CURRENT_SOURCE_DIR}/config/interface_schema.yaml")
set(GEN_HEADER "${CMAKE_CURRENT_BINARY_DIR}/interface_data.h")
set(GEN_SCRIPT "${WORKSPACE_DIR}/zenbedded_transport/tools/generate_tier2_payload.py")

add_custom_command(
  OUTPUT ${GEN_HEADER}
  COMMAND python3 ${GEN_SCRIPT} --yaml ${SCHEMA_FILE} --output ${GEN_HEADER}
  DEPENDS ${SCHEMA_FILE} ${GEN_SCRIPT}
  COMMENT "Generating Tier 2 C-Header natively via Python"
)
add_custom_target(generate_tier2_header ALL DEPENDS ${GEN_HEADER})

# 3. Build the Application
zephyr_compile_definitions(Z_CONFIG_SOCKET_TIMEOUT=1)
zephyr_include_directories(${CMAKE_CURRENT_BINARY_DIR})

target_sources(app PRIVATE src/main.cpp)
add_dependencies(app generate_tier2_header)
```

## prj.conf
```kconfig
CONFIG_CPP=y
CONFIG_STD_CPP17=y
CONFIG_REQUIRES_FULL_LIBC=y

# Enable Tier 2 (Raw Structs) instead of Tier 1 (ZCDR)
CONFIG_ZENBEDDED_TIER_2=y

# Optional for this demo as its in the right default path, only use this if the user wants a different path
CONFIG_ZENBEDDED_TIER2_SCHEMA_PATH="config/interface_schema.yaml"

CONFIG_LOG=y
CONFIG_LOG_MODE_IMMEDIATE=y
CONFIG_ZENBEDDED_TRANSPORT_LOG_LEVEL=3
```

## src/main.cpp
```c
// Copyright 2026 Open Source Robotics Foundation, Inc.
//
// Licensed under the Apache License, Version 2.0 (the "License");
// you may not use this file except in compliance with the License.
// You may obtain a copy of the License at
//
//     http://www.apache.org/licenses/LICENSE-2.0
//
// Unless required by applicable law or agreed to in writing, software
// distributed under the License is distributed on an "AS IS" BASIS,
// WITHOUT WARRANTIES OR CONDITIONS OF ANY KIND, either express or implied.
// See the License for the specific language governing permissions and
// limitations under the License.

#include <zephyr/kernel.h>
#include <zephyr/logging/log.h>

// This header MUST be generated at build-time
#include "zenbedded_transport/generated/interface_data.h"  // NOLINT
#include "zenbedded_transport/zenoh_transport.h"

LOG_MODULE_REGISTER(tier2_test, LOG_LEVEL_INF);

int main(void)
{
  LOG_INF("Starting Zenbedded Tier 2 Transport Test");

  zenbedded_state_t my_state;
  my_state.test_motor_position = 1.23;
  my_state.test_motor_velocity = 0.55;

  // Simulate passing the raw bytes to the dumb transport pipe
  const uint8_t * raw_bytes = reinterpret_cast<const uint8_t *>(&my_state);
  size_t size = sizeof(zenbedded_state_t);

  LOG_INF("Packed Tier 2 Struct. Total bytes to send: %zu", size);
  LOG_HEXDUMP_INF(raw_bytes, size, "Packed Tier 2 struct");

  while (1)
  {
    k_sleep(K_MSEC(1000));
  }
  return 0;
}
```
