## CMakeLists.txt
```
### As a standalone application
cmake_minimum_required(VERSION 3.20.0)

find_package(Zephyr REQUIRED HINTS $ENV{ZEPHYR_BASE})

project(zephyr_firmware)

target_sources(app PRIVATE
    src/main.cpp
    lib/component_manager.cpp
    lib/hardware_component.cpp
)

target_include_directories(app PRIVATE include)




### As a library

# zephyr_library()
# zephyr_library_sources(
#     lib/component_manager.cpp
#     lib/hardware_component.cpp
# )
# zephyr_library_link_libraries(zenoh-pico)
# zephyr_library_include_directories(include)
```

## Kconfig
```
mainmenu "zenbedded config"

source "Kconfig.zephyr"
```

## west.yml
```
# using Zephyr v3.7.0 and zenoh-pico v1.9.0


manifest:

  remotes:
    - name: zephyrproject-rtos
      url-base: https://github.com/zephyrproject-rtos
    - name: eclipse-zenoh
      url-base: https://github.com/eclipse-zenoh/zenoh-pico

  defaults:
    remote: zephyrproject-rtos

  projects:
    - name: zephyr_firmware
      remote: zephyrproject-rtos
      revision: 3.7.0
      import: true
    - name: zenoh-pico
      revision: 1.9.0
      path: modules/lib/zenoh-pico

  self:
    path: zephyr_firmware
```

## prj.conf
```kconfig
CONFIG_CPP=y
CONFIG_REQUIRES_FULL_LIBCPP=y

# CONFIG_ZENOH_PICO=y
# CONFIG_ZENOH_PICO_TRANSPORT_UDP=y
# CONFIG_ZENOH_PICO_PUBLICATION=y
# CONFIG_ZENOH_PICO_SUBSCRIPTION=y

# CONFIG_NETWORKING=y
# CONFIG_NET_SOCKETS=y
# CONFIG_POSIX_API=y
# CONFIG_NET_IPV4=y

# CONFIG_HEAP_MEM_POOL_SIZE=16384
# CONFIG_MAIN_STACK_SIZE=4096
```

## src/main.cpp
```c
// Copyright 2026 Open Source Robotics Foundation, Inc.
//
// Licensed under the Apache License, Version 2.0 (the "License");
// you may not use this file except in compliance with the License.
// You may obtain a copy of the License at
//
//     https://www.apache.org/licenses/LICENSE-2.0
//
// Unless required by applicable law or agreed to in writing, software
// distributed under the License is distributed on an "AS IS" BASIS,
// WITHOUT WARRANTIES OR CONDITIONS OF ANY KIND, either express or implied.
// See the License for the specific language governing permissions and
// limitations under the License.

#include <iostream>

int main(void)
{
  std::cout << "Hello, C++ world! " << std::endl;
  return 0;
}
```
